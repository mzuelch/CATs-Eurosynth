#include <avr/io.h>//for fast PWM
#define PWMPin 10
#define TRIGPin 3

// This code is from the dual AD Envelope generator HAGIWO made.
//
// More Info here: https://note.com/solder_state/n/n6fb73eb1d8b8 and here https://www.youtube.com/watch?v=yAes5pS3ZTo
// 
// Pot 0 -> Attack time
// Pot 1 -> Release time
// pot 2 -> Voltage level
// Pot 3 -> curve shape (slow tri to steep exponential)

int atk1, rel1, lev1, con1, out1, count1;
//count -- 0 is not triggerd , 1 is attack duration , 2 is release duration.
bool in1, old_in1;
int i = 0;//CH1 count
int last_out1 = 0; //If retriggered at the release time, the CV voltage will be restarted from the middle of the line, not from zero.
long timer1 = 0;

const static byte curve[16][128] PROGMEM = {
  {0, 4, 7, 10, 14, 17, 21, 24, 27, 31, 34, 37, 40,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 254, 255},
  {0, 4, 8, 12, 16, 20, 24, 27, 31, 35, 38, 42, 46,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 254, 255},
  {0, 5, 9, 14, 18, 23, 27, 31, 35, 39, 43, 47, 51,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 254, 255},
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  {0, 17, 33, 48, 62, 75, 87, 99, 109, 119, 128, 137, 145,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 255, 255}
};

void setup()
{
  Serial.begin(9600);
  pinMode(TRIGPin, INPUT) ;//Z button
  pinMode(PWMPin, OUTPUT) ;//accelx
  timer1 = micros();
  TCCR1B &= B11111000;//fast pwm setting
  TCCR1B |= B00000001;//fast pwm setting
  delay(50);
}

void loop()
{
  old_in1 = in1;
  in1 = digitalRead(TRIGPin);// trig input

  if (old_in1 == 0 && in1 == 1) {// if detect trigger
    if (count1 == 2) {
      last_out1 = out1;
    }
    else if (count1 != 2) {
      last_out1 = 0;
    }
    i = 0;//wave table count reset
    count1 = 1;//start attack duration
    atk1 = analogRead(0) * 12; // Pot 0
    rel1 = analogRead(1) * 16; // Pot 1
    lev1 = analogRead(3) / 4; // pot 2
    con1 = analogRead(5) / 64; // Pot3
  }

  else if (count1 == 1 && i > 127) {//attack duration end
    count1 = 2;//start release duration
  }
  else if (count1 == 2 && i > 255) {//release duration end
    count1 = 0;
  }

  //----------------------CV output buffer CH1-------------------------
  if (count1 == 1) {//attack
    if (atk1 <= 32) {//Minimize atk time
      i = 128;
      count1 = 2;
    }
    out1 = (pgm_read_byte(&(curve[con1][i])));//store output voltage value
    if (timer1 + atk1 <= micros()) {
      i++;
      timer1 = micros();
    }
  }

  else if (count1 == 2) {//release
    out1 = 255 - (pgm_read_byte(&(curve[con1][i - 128])));//store output voltage value
    if (timer1 + rel1 <= micros()) {
      i++;
      timer1 = micros();
    }
  }

  //----------------------CV output-------------------------
  PWM_OUT();//CV out
}
void PWM_OUT() {//PWM duty setting
  if (count1 == 1) {
    out1 = map(out1, 0, 255, last_out1, lev1);
  }
  else if (count1 == 2) {
    out1 = map(out1, 0, 255, 0, lev1);
  }
  analogWrite(PWMPin, out1);//PWM output
}
