#include <FlexiTimer2.h>

#include <avr/io.h>
#define PWMPin 10

unsigned int frq = 50000; // PWM周波数。60kHzあたりまで機能するが、マージンとって50kHzとする。
float duty = 0.5; // duty比率
int count = 0;

byte mode = 1;//
//0=saw1
//1=saw2
//2=sine
//3=tri
//4=squ
//5=random
//6=steady

int set_freq = 1;//
int freq_max = 30;//外部クロック周期(*100usec)
int amp = 1;//change pwm duty
float amp_rate = 1.0;
int phase = 1;
int mod = 0;//self modulation

bool ext_injudge = 0;//0=use internal clock , 1 = use external clock
bool ext_pulse = 0;//0=no external in
bool old_ext_pulse = 0;
long ext_count = 0;
long ext_count_result = 0;
long old_ext_count_result = 0;
long ext_period = 0;
bool reset_count = 0;

//wave table
const static word saw1[1000] PROGMEM = {
 0,  1,  2,  3,  4,  5,  6,  7,  8,  9,  10, 11,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  999
};
const static word saw2[1000] PROGMEM = {
 999,  998,  997,  996,  995,  994,  993,  992,  991,  990,  989,  988,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  0
};
const static word sine[1000] PROGMEM = {
 500,  500,  500,  500,  510,  510,  510,  520,  520,  520,  530,  530,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  490
};
const static word tri[1000] PROGMEM = {
 0,  2,  4,  6,  8,  10, 12, 14, 16, 18, 20, 22,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  2
};
const static word squ[1000] PROGMEM = {
 0,  0,  0,  0,  0,  0,  0,  0,  0,  0,  0,  0,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 1000
};


void setup() {
 pinMode(PWMPin, OUTPUT);
 pinMode(3, INPUT);

 FlexiTimer2::set(5, 1.0 / 100000, timer_count); // 50usec/count
 FlexiTimer2::start();

 //for development
//  Serial.begin(9600);

}

void loop() {
 old_ext_pulse = ext_pulse;
 ext_pulse = digitalRead(3);

 //------------wave select-------------------------------
 if (analogRead(3) < 31) {
   mode = 6;//steady
 }
 else if (analogRead(3) >= 31 && analogRead(3) < 155) {
   mode = 0;//saw1
 }
 else if (analogRead(3) >= 155 && analogRead(3) < 352) {
   mode = 1;//saw2
 }
 else if (analogRead(3) >= 352 && analogRead(3) < 571) {
   mode = 2;//sin
 }
 else if (analogRead(3) >= 571 && analogRead(3) < 771) {
   mode = 3;//tri
 }
 else if (analogRead(3) >= 771 && analogRead(3) < 939) {
   mode = 4;//squ
 }
 else if (analogRead(3) >= 939) {
   mode = 5;//random
 }


 //------------phase and internal clock set-------------------------------
 if (ext_injudge == 0) { //use internal clock , phase function off
   phase = 0;
   //    freq_max = 1+(analogRead(1))/5;
   freq_max = 1 + 0.0007 * analogRead(1) * analogRead(1);
 }

 else if (ext_injudge == 1) { //use external clock , phase function on
   phase = map(analogRead(1), 0, 1023, 0, 999);
 }


 //------------selc modulation-------------------------------
 if (analogRead(5) < 31) {
   mod = 0;//no modulation
 }
 else if (analogRead(5) >= 31 && analogRead(5) < 155) {
   mod = 1;//saw1
 }
 else if (analogRead(5) >= 155 && analogRead(5) < 352) {
   mod = 2;//saw2
 }
 else if (analogRead(5) >= 352 && analogRead(5) < 571) {
   mod = 3;//sin
 }
 else if (analogRead(5) >= 571 && analogRead(5) < 771) {
   mod = 4;//tri
 }
 else if (analogRead(5) >= 771 && analogRead(5) < 939) {
   mod = 5;//squ
 }
 else if (analogRead(5) >= 939) {
   mod = 6;//random
 }

 switch (mod) {
   case 0:
     break;

   case 1:
     phase = phase + (pgm_read_word(&(saw1[count])));
     break;

   case 2:
     phase = phase + (pgm_read_word(&(saw2[count])));
     break;

   case 3:
     phase = phase + (pgm_read_word(&(sine[count])));
     break;

   case 4:
     phase = phase + (pgm_read_word(&(tri[count])));
     break;

   case 5:
     phase = phase + (pgm_read_word(&(squ[count])));
     break;

   case 6:
     phase = phase + (pgm_read_word(&(saw1[random(1, 1000)])));
     break;
 }

 //--------------amp set----------------
 amp = analogRead(0);
 amp = map(amp, 0, 1023, 1, 100);
 amp_rate = (float)amp / 100;


 //------------external in judge-------------------------------
 if ( ext_count > 160000 ) { //no external signal during 8 sec
   ext_injudge = 0;
 }
 else  {
   ext_injudge = 1;
 }


 //----------clock setting-------------

 if (ext_pulse == 1 && old_ext_pulse == 0) {
   old_ext_count_result = ext_count_result;//twice pulse average
   ext_count_result = ext_count;
   ext_period = (old_ext_count_result + ext_count_result) / 1960;
   freq_max = ext_period;
 }

 if ( old_ext_pulse == 0 && ext_pulse == 1  ) { //外部入力が有→無のとき
   ext_count = 0;
   count = 0;

 }
 // モード指定
 TCCR1A = 0b00100001;
 TCCR1B = 0b00010001;//分周比1

 // TOP値指定
 OCR1A = (unsigned int)(8000000 / frq);

 // Duty比指定
 OCR1B = (unsigned int)(8000000  / frq * duty * amp_rate);

 // for development
 //  Serial.print(ext_injudge);
 //  Serial.print(",");
 //  Serial.print(analogRead(5));
 //  Serial.println("");
}

void timer_count() {

 ext_count ++;
 set_freq ++;
 
 if (set_freq >= freq_max) {
   set_freq = 0;

   count ++;
   if (count + phase >= 1000 && mode != 5) {
     count = count - 1000;
   }

   switch (mode) {
     case 0:
       duty = (float)(pgm_read_word(&(saw1[count + phase]))) / 1000;
       break;

     case 1:
       duty = (float)(pgm_read_word(&(saw2[count + phase]))) / 1000;
       break;

     case 2:
       duty = (float)(pgm_read_word(&(sine[count + phase]))) / 1000;
       break;

     case 3:
       duty = (float)(pgm_read_word(&(tri[count + phase]))) / 1000;
       break;

     case 4:
       duty = (float)(pgm_read_word(&(squ[count + phase]))) / 1000;
       break;
   }

   //random
   if (mode == 5) {
     count ++;
     if (count >= 250) {
       count = 0;
       duty = random(1, 1000);
       duty = duty / 1000;
     }
   }

   //steady
   if (mode == 6) {
     duty = 1;
   }
 }
}